## CMakeLists.txt
```
cmake_minimum_required(VERSION 3.20.0)

find_package(Zephyr REQUIRED HINTS $ENV{ZEPHYR_BASE})
project(dji_m3508_demo)

target_sources(app PRIVATE src/main.c src/knob_haptic.c)
```

## prj.conf
```kconfig
# DJI M3508电机控制示例配置 - 飞机旋钮虚拟档位

# 基础配置
CONFIG_MAIN_THREAD_PRIORITY=7
CONFIG_SYSTEM_WORKQUEUE_STACK_SIZE=2048

# 手感控制线程需要 1 ms 调度粒度
CONFIG_SYS_CLOCK_TICKS_PER_SEC=1000

# 电机驱动支持
CONFIG_MOTOR=y
CONFIG_MOTOR_DJI=y

# CAN总线支持
CONFIG_CAN=y
CONFIG_CAN_INIT_PRIORITY=80
```

## src/main.c
```c
/*
 * DJI M3508 飞机旋钮虚拟档位手感示例
 *
 * 通过虚拟弹簧 + 阻尼 + 越档顿挫脉冲，在没有机械档位的旋钮上生成
 * “一档一档”的力矩反馈。手感参数集中在 knob_params 中，可整体替换以扩展
 * 其他旋钮手感。
 *
 * 力矩下发路径：
 *   手感算法输出力矩(N·m) -> motor_set(VO / MOTOR_TARGET_TORQUE)
 *   -> 驱动按 gear_ratio 与 TORQUE2CURRENT 换算为电流指令
 *   -> C620 电调内部电流环执行
 *
 * M3508 没有力矩传感器，motor_status_t.torque 是由反馈电流换算出的估计值，
 * 因此这里无法做真正的力矩闭环，只能做“力矩指令 -> 电流闭环”。
 *
 * Copyright (c) 2024 ttwards
 * SPDX-License-Identifier: Apache-2.0
 */

#include <zephyr/kernel.h>
#include <zephyr/device.h>
#include <zephyr/drivers/motor.h>
#include <zephyr/logging/log.h>
#include <math.h>

#include "knob_haptic.h"

LOG_MODULE_REGISTER(dji_m3508_demo, LOG_LEVEL_INF);

// 电机设备定义
#define M3508_NODE DT_NODELABEL(m3508_motor)
static const struct device *const m3508_motor = DEVICE_DT_GET(M3508_NODE);

// 控制周期：1 kHz，与 C620 的 1 kHz 周期反馈匹配
#define KNOB_CONTROL_PERIOD_MS 1
// 安全转速：超过后切断输出力矩，避免手感算法在异常高速下继续加力
#define KNOB_SAFE_MAX_RPM      300.0f

/*
 * 手感参数（输出轴侧，30°/档，一圈 12 档）
 *
 * 档位边界处弹簧力矩 = spring_stiffness * detent_spacing_deg / 2 = 0.375 N·m，
 * 峰值仍受 max_torque 限制，便于在低减速比/高负载机构上快速调参。
 */
static const struct knob_feel_params knob_params = {
	.detent_spacing_deg = 30.0f,     // 档位间距
	.spring_stiffness = 0.025f,      // 虚拟弹簧刚度 N·m/deg
	.damping = 0.0015f,              // 阻尼 N·m/rpm，100 rpm 时约 0.15 N·m
	.detent_impulse = 0.45f,         // 越档顿挫脉冲峰值 N·m
	.impulse_decay_ms = 12.0f,       // 脉冲衰减时间常数 ms
	.max_torque = 1.2f,              // 力矩限幅 N·m
	.torque_slew_rate = 120.0f,      // 力矩变化率限幅 N·m/s
	.velocity_lpf_alpha = 0.85f,     // 转速低通系数
	.crossing_hysteresis_deg = 1.0f, // 越档回滞
	.deadband_deg = 0.2f,            // 档位中心死区
};

static struct knob_haptic knob;
static volatile bool knob_ready;

/**
 * @brief 下发输出轴力矩指令
 *
 * 同时写入力矩限幅，覆盖驱动默认的 ±99999，防止异常参数下电流打满。
 */
static void knob_apply_torque(float torque_nm)
{
	motor_setpoint_t setpoint = {
		.torque = torque_nm,
		.mode = VO,
		.target = MOTOR_TARGET_TORQUE,
		.torque_limit = {-knob_params.max_torque, knob_params.max_torque},
		.speed_limit = {-KNOB_SAFE_MAX_RPM, KNOB_SAFE_MAX_RPM},
	};

	(void)motor_set(m3508_motor, &setpoint);
}

/**
 * @brief 1 kHz 手感控制线程
 */
static void knob_control_thread(void *arg1, void *arg2, void *arg3)
{
	static bool link_was_online;

	ARG_UNUSED(arg1);
	ARG_UNUSED(arg2);
	ARG_UNUSED(arg3);

	while (1) {
		k_msleep(KNOB_CONTROL_PERIOD_MS);

		if (!knob_ready) {
			continue;
		}

		motor_status_t status;

		if (motor_get(m3508_motor, &status) != 0) {
			knob_apply_torque(0.0f);
			link_was_online = false;
			continue;
		}

		/* 离线时驱动不会下发电流；超速时主动切断，避免失控 */
		if (!status.online) {
			knob_apply_torque(0.0f);
			link_was_online = false;
			continue;
		}

		if (!link_was_online) {
			/* 重新上线：以当前位置重新对齐档位，避免断线期间转动
			 * 造成的角度跳变与力矩冲击。
			 */
			knob_haptic_init(&knob, &knob_params, status.sum_angle,
					 k_uptime_get_32());
			link_was_online = true;
		}

		if (!status.enabled || fabsf(status.rpm) > KNOB_SAFE_MAX_RPM) {
			knob_apply_torque(0.0f);
			continue;
		}

		float torque = knob_haptic_update(&knob, status.sum_angle, status.rpm,
						  k_uptime_get_32());

		knob_apply_torque(torque);
	}
}

K_THREAD_DEFINE(knob_control, 1536, knob_control_thread, NULL, NULL, NULL, 3, 0, 0);

/**
 * @brief 手感状态监控线程
 */
void motor_monitor_thread(void *arg1, void *arg2, void *arg3)
{
	ARG_UNUSED(arg1);
	ARG_UNUSED(arg2);
	ARG_UNUSED(arg3);

	while (1) {
		k_msleep(1000);

		motor_status_t status;
		int ret = motor_get(m3508_motor, &status);

		if (ret != 0) {
			LOG_ERR("读取电机状态失败: %d", ret);
			continue;
		}

		LOG_INF("档位 %d | 角度 %.1f° | 转速 %.1f rpm | 指令 %.2f N·m | 越档 %u 次 | 在线 %d",
			knob_haptic_detent(&knob), (double)status.sum_angle, (double)status.rpm,
			(double)knob.torque, (unsigned int)knob_haptic_crossings(&knob),
			status.online);
	}
}

K_THREAD_DEFINE(motor_monitor, 1024, motor_monitor_thread, NULL, NULL, NULL, 5, 0, 0);

/**
 * @brief 主函数
 */
int main(void)
{
	LOG_INF("=== DJI M3508 飞机旋钮虚拟档位手感 ===");
	LOG_INF("档位间距 %.0f°, 一圈 %d 档, 力矩限幅 %.2f N·m",
		(double)knob_params.detent_spacing_deg, (int)(360.0f / knob_params.detent_spacing_deg),
		(double)knob_params.max_torque);

	if (!device_is_ready(m3508_motor)) {
		LOG_ERR("M3508电机设备未就绪");
		return -ENODEV;
	}

	motor_control(m3508_motor, ENABLE_MOTOR);
	LOG_INF("电机已启用");

	/* 等待 C620 周期反馈，确认总线与供电正常 */
	motor_status_t status = {0};
	bool online = false;

	for (int i = 0; i < 200; i++) {
		if (motor_get(m3508_motor, &status) == 0 && status.online) {
			online = true;
			break;
		}
		k_msleep(10);
	}

	if (!online) {
		LOG_ERR("未收到 M3508 周期反馈，请检查 CAN 接线、电机 ID 与 24V 供电");
		motor_control(m3508_motor, DISABLE_MOTOR);
		return -ENODEV;
	}

	/* 以当前位置为档位 0，便于观察档位编号 */
	motor_control(m3508_motor, SET_ZERO);
	k_msleep(20);

	motor_get(m3508_motor, &status);
	knob_haptic_init(&knob, &knob_params, status.sum_angle, k_uptime_get_32());
	knob_ready = true;

	LOG_INF("手感已启动，转动旋钮即可感受虚拟档位");

	return 0;
}
```

## src/knob_haptic.c
```c
/*
 * 虚拟档位（detent）旋钮手感算法
 *
 * Copyright (c) 2025
 * SPDX-License-Identifier: Apache-2.0
 */

#include "knob_haptic.h"

#include <math.h>
#include <string.h>

#include <zephyr/sys/util.h>

/* 把角度折算到 [-period/2, period/2)，用于求相对最近档位中心的偏移 */
static float wrap_to_period(float angle, float period)
{
	float wrapped = fmodf(angle, period);

	if (wrapped > period * 0.5f) {
		wrapped -= period;
	} else if (wrapped < -period * 0.5f) {
		wrapped += period;
	}

	return wrapped;
}

static int32_t detent_of(float angle_deg, float spacing_deg)
{
	if (spacing_deg <= 0.0f) {
		return 0;
	}

	return (int32_t)floorf(angle_deg / spacing_deg + 0.5f);
}

void knob_haptic_init(struct knob_haptic *knob, const struct knob_feel_params *params,
		      float angle_deg, uint32_t now_ms)
{
	if (knob == NULL) {
		return;
	}

	memset(knob, 0, sizeof(*knob));
	if (params != NULL) {
		knob->params = *params;
	}

	knob->angle_deg = angle_deg;
	knob->last_time_ms = now_ms;
	knob->detent_index = detent_of(angle_deg, knob->params.detent_spacing_deg);
	knob->primed = true;
}

float knob_haptic_update(struct knob_haptic *knob, float angle_deg, float rpm, uint32_t now_ms)
{
	if (knob == NULL) {
		return 0.0f;
	}

	const struct knob_feel_params *p = &knob->params;

	/* 参数非法时保持输出为 0，避免除零与无界输出 */
	if (p->detent_spacing_deg <= 0.0f || p->max_torque <= 0.0f) {
		knob->torque = 0.0f;
		return 0.0f;
	}

	float dt = (float)(int32_t)(now_ms - knob->last_time_ms) * 0.001f;

	/* 同一毫秒内重复调用时按 1 ms 处理，保证算法结果可复现 */
	if (dt <= 0.0f) {
		dt = 0.001f;
	} else if (dt > 0.1f) {
		/* 线程被长时间阻塞后不要用超大 dt 积分，避免力矩突变 */
		dt = 0.1f;
	}
	knob->last_time_ms = now_ms;

	/* 转速低通：C620 的转速反馈量化到 1 rpm，直接做阻尼会引入抖动 */
	float alpha = CLAMP(p->velocity_lpf_alpha, 0.0f, 0.999f);

	knob->rpm_filt = alpha * knob->rpm_filt + (1.0f - alpha) * rpm;

	/* 1. 虚拟弹簧：把旋钮拉回最近的档位中心，天然具有周期性 */
	float offset = wrap_to_period(angle_deg, p->detent_spacing_deg);

	if (fabsf(offset) < p->deadband_deg) {
		offset = 0.0f;
	}

	float torque = -p->spring_stiffness * offset;

	/* 2. 阻尼力矩：始终与转速反向，抑制快速旋转时的振荡 */
	torque -= p->damping * knob->rpm_filt;

	/* 3. 越档检测：档位编号变化且越过回滞带才算一次越档，
	 *    快速旋转时允许一个周期内跨过多个档位。
	 */
	int32_t raw_index = detent_of(angle_deg, p->detent_spacing_deg);
	int32_t delta = raw_index - knob->detent_index;

	if (delta != 0) {
		float edge = (delta > 0 ? (float)knob->detent_index + 0.5f
					: (float)knob->detent_index - 0.5f) *
			     p->detent_spacing_deg;
		bool crossed = (delta > 0) ? (angle_deg >= edge + p->crossing_hysteresis_deg)
					   : (angle_deg <= edge - p->crossing_hysteresis_deg);

		if (crossed) {
			knob->detent_index = raw_index;
			knob->crossings += (uint32_t)(delta > 0 ? delta : -delta);

			/* 4. 越档顿挫脉冲：方向与转动方向相反，形成“咔哒”阻尼感。
			 *    衰减过程在下方统一处理。
			 */
			if (p->detent_impulse > 0.0f) {
				knob->impulse = (delta > 0) ? -p->detent_impulse : p->detent_impulse;
			}
		}
	}

	/* 越档脉冲按指数衰减 */
	if (knob->impulse != 0.0f) {
		if (p->impulse_decay_ms > 0.0f) {
			knob->impulse *= expf(-dt * 1000.0f / p->impulse_decay_ms);
		} else {
			knob->impulse = 0.0f;
		}
	}

	torque += knob->impulse;

	/* 5. 力矩限幅 */
	torque = CLAMP(torque, -p->max_torque, p->max_torque);

	/* 6. 力矩变化率限幅：抑制电流指令突变，降低机械冲击与振荡风险 */
	if (p->torque_slew_rate > 0.0f) {
		float max_step = p->torque_slew_rate * dt;

		torque = CLAMP(torque, knob->torque - max_step, knob->torque + max_step);
	}

	if (!isfinite(torque)) {
		torque = 0.0f;
	}

	knob->angle_deg = angle_deg;
	knob->torque = torque;

	return torque;
}
```

## src/knob_haptic.h
```c
/*
 * 虚拟档位（detent）旋钮手感算法
 *
 * Copyright (c) 2025
 * SPDX-License-Identifier: Apache-2.0
 */

#ifndef KNOB_HAPTIC_H_
#define KNOB_HAPTIC_H_

#include <stdbool.h>
#include <stdint.h>

/**
 * @brief 档位手感参数
 *
 * 角度与转速均为输出轴侧数值（与 motor_status_t 一致），力矩单位为 N·m，
 * 同样是输出轴侧力矩。所有参数在运行时只读，修改后需重新初始化。
 */
struct knob_feel_params {
	/** 相邻档位中心夹角，单位 deg，必须 > 0 */
	float detent_spacing_deg;
	/** 虚拟弹簧刚度，单位 N·m/deg；档位边界处力矩约为 stiffness * spacing / 2 */
	float spring_stiffness;
	/** 阻尼系数，单位 N·m/rpm，输出力矩与转速反向 */
	float damping;
	/** 越档脉冲峰值力矩，单位 N·m；为 0 时关闭越档顿挫 */
	float detent_impulse;
	/** 越档脉冲指数衰减时间常数，单位 ms，必须 > 0 */
	float impulse_decay_ms;
	/** 输出力矩限幅，单位 N·m，必须 > 0 */
	float max_torque;
	/** 力矩变化率限幅，单位 N·m/s；为 0 时不做限制 */
	float torque_slew_rate;
	/** 转速低通系数 [0, 1)，越大越平滑，用于抑制 CAN 反馈量化噪声 */
	float velocity_lpf_alpha;
	/** 越档回滞，单位 deg，抑制档位边界处的来回抖动 */
	float crossing_hysteresis_deg;
	/** 档位中心死区，单位 deg，避免静摩擦下在中心点附近微振 */
	float deadband_deg;
};

/**
 * @brief 虚拟档位手感运行状态
 *
 * 由 knob_haptic_init() 初始化，之后每个控制周期调用 knob_haptic_update()。
 * 字段对外只读，便于上层做遥测与调试。
 */
struct knob_haptic {
	struct knob_feel_params params;
	/** 上一周期的角度 */
	float angle_deg;
	/** 低通后的转速 */
	float rpm_filt;
	/** 当前越档脉冲力矩（带符号） */
	float impulse;
	/** 上一周期输出的力矩 */
	float torque;
	/** 当前档位编号，档位中心为 index * detent_spacing_deg */
	int32_t detent_index;
	uint32_t last_time_ms;
	/** 累计越档次数 */
	uint32_t crossings;
	bool primed;
};

/**
 * @brief 初始化手感状态
 *
 * 以传入角度作为当前档位，清零越档计数。
 *
 * @param knob      手感状态
 * @param params    手感参数
 * @param angle_deg 当前输出轴角度，单位 deg
 * @param now_ms    当前时间，单位 ms
 */
void knob_haptic_init(struct knob_haptic *knob, const struct knob_feel_params *params,
		      float angle_deg, uint32_t now_ms);

/**
 * @brief 计算一个控制周期的输出力矩
 *
 * 输出 = 虚拟弹簧力矩 + 阻尼力矩 + 越档脉冲力矩，并依次经过
 * 力矩限幅与力矩变化率限幅。
 *
 * @param knob      手感状态
 * @param angle_deg 当前输出轴角度，单位 deg（应使用多圈累计角度）
 * @param rpm       当前输出轴转速，单位 rpm
 * @param now_ms    当前时间，单位 ms
 * @return 输出轴力矩指令，单位 N·m
 */
float knob_haptic_update(struct knob_haptic *knob, float angle_deg, float rpm, uint32_t now_ms);

/** @brief 当前档位编号 */
static inline int32_t knob_haptic_detent(const struct knob_haptic *knob)
{
	return knob->detent_index;
}

/** @brief 累计越档次数 */
static inline uint32_t knob_haptic_crossings(const struct knob_haptic *knob)
{
	return knob->crossings;
}

#endif /* KNOB_HAPTIC_H_ */
```
